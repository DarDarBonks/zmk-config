## config/west.yml
```yaml
manifest:
  remotes:
    - name: zmkfirmware
      url-base: https://github.com/zmkfirmware
    - name: DarDarBonks
      url-base: https://github.com/DarDarBonks
  projects:
    - name: zmk
      remote: zmkfirmware
      revision: v0.3
      import: app/west.yml
    - name: nice-view-dardar
      remote: DarDarBonks
      revision: main
  self:
    path: config
```
